## lib/yuck/Kconfig.proj
```kconfig
menu "Project Configuration"

config USE_LIBRARY_1
    bool "link library_1 to executable"
    default y

config DEF_FOO
    bool "Define FOO when enabled"
    default n

config PROJECT_NAME
    string "Project name"
    default "PROJECT_NAME"
```
